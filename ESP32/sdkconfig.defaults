## ESP32/sdkconfig.defaults
```kconfig
# Project-level IDF defaults. PIO regenerates per-env sdkconfig from this file
# on each build (the per-env file is gitignored). This is the source of truth —
# changes here propagate to every build.

# ---- Flash ----
# ESP32 generic dev board → 4 MB flash. (Default detected as 2 MB causes a warning
# at link time + breaks our dual-OTA partition table that runs up to 0x320000.)
CONFIG_ESPTOOLPY_FLASHSIZE_4MB=y
CONFIG_ESPTOOLPY_FLASHSIZE="4MB"

# ---- Partition table ----
# Custom dual-OTA (1.5 MB app slots) — see partitions.csv. The IDF default
# `default.csv` only provides 1 MB app slots, which the firmware exceeds after
# Phase 3 (esp_https_ota + TLS + esp_wifi).
CONFIG_PARTITION_TABLE_CUSTOM=y
CONFIG_PARTITION_TABLE_CUSTOM_FILENAME="partitions.csv"
CONFIG_PARTITION_TABLE_OFFSET=0x8000

# ---- OTA rollback ----
# REQUIREMENTS.md FR-17: a freshly-flashed OTA image must mark itself valid
# within a window (app must call esp_ota_mark_app_valid_cancel_rollback()
# after a healthy boot); otherwise the bootloader rolls back on the next reset.
# Phase 6 firmware doesn't yet call mark_valid — Phase 5 builds + boots, but the
# rollback marking is a follow-up TODO in main.cpp.
CONFIG_BOOTLOADER_APP_ROLLBACK_ENABLE=y

# ---- Logging ----
# INFO default; DEBUG via menuconfig per-build. ESP_LOGE/W/I/D map to this.
CONFIG_LOG_DEFAULT_LEVEL_INFO=y

# ---- MQTT (esp-mqtt) ----
# 8 KB outbox so retained meta-topic batches don't fragment the publish queue.
CONFIG_MQTT_OUTBOX_DATA_ON_MEMORY_BUFFER_SIZE_KB=8
```
